AUTOSAR XML (schema 00049)
package /RootPack/NewPack
  application sw component type newcomponent
    provide port outPort
package /RootPack/NewPack/signals
  i signal sig1: length=0
package /RootPack/NewPack/systemsignals
  system signal syssig1
